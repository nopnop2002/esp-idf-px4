## main/Kconfig.projbuild
```kconfig
menu "Application Configuration"

	config ESP_WIFI_SSID
		string "WiFi SSID"
		default "myssid"
		help
			SSID (network name) for the example to connect to.

	config ESP_WIFI_PASSWORD
		string "WiFi Password"
		default "mypassword"
		help
			WiFi password (WPA or WPA2) for the example to use.

	config ESP_MAXIMUM_RETRY
		int "Maximum retry"
		default 5
		help
			Set the Maximum retry to avoid station reconnecting to the AP unlimited when the AP is really inexistent.

	config UDP_PORT
		int "Port number of PX4 MAVLink UDP"
		default 14540
		help
			Port number of PX4 MAVLink UDP.
			UDP Port 14540 is used for communication with offboard APIs.
			Offboard APIs are expected to listen for connections on this port.

	config BAD_CRC
		bool "Display packets with CRC error"
		default false
		help
			Display packets with CRC error.

	choice ESP_FONT
		bool "Select font"
		default ESP_FONT_GOTHIC
		help
			Select font.

		config ESP_FONT_GOTHIC
			bool "Gothic"
		config ESP_FONT_MINCYO
			bool "Mincyo"
	endchoice

endmenu
```
